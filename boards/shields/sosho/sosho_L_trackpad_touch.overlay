#include "sosho_L.dtsi"

/*
 * Official Zephyr Cirque Pinnacle driver touch profile.
 * The hardware is single-touch: primary taps are available, two quick taps
 * are interpreted as a double-click by the host, and a held contact plus
 * movement is drag-and-drop. Multi-finger gestures are not claimed here.
 */
&spi0 { status = "okay"; };
&glidepoint {
    status = "okay";
    invert-x;
    data-mode = "absolute";
    clipping-enable;
    scaling-enable;
    scaling-x-resolution = <2048>;
    scaling-y-resolution = <1536>;
    /* Keep the touch profile at the official maximum sensitivity while
     * validating the hardware and preserving primary taps. */
    sensitivity = "1x";
    /* primary-tap-enable is declared once in sosho.dtsi. */
};
&glidepoint_split {
    status = "okay";
    device = <&glidepoint>;
    input-processors = <&sosho_trackpad_edge_scroll>;
};
