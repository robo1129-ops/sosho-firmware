#include "sosho_L.dtsi"

&spi0 { status = "okay"; };
&glidepoint {
    status = "okay";
    invert-x;
    /* The physical pad orientation reports vertical motion inverted. */
    invert-y;
    /* Use the official Pinnacle relative path.  It emits REL_X/REL_Y and
     * BTN_TOUCH in the order expected by ZMK's split input listener.  The
     * previous absolute-coordinate path depended on a custom X/Y/Z frame
     * state machine; when the touch controller or split link delivered a
     * frame without the expected pressure transition, every movement was
     * suppressed and the pad appeared dead. */
    data-mode = "relative";
    primary-tap-enable;
    sensitivity = "1x";
};
&glidepoint_split {
    status = "okay";
    device = <&glidepoint>;
};
