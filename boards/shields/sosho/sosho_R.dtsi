#include "sosho.dtsi"
#include <dt-bindings/zmk/input_transform.h>
#include <input/processors.dtsi>

&default_transform {
    col-offset = <6>;
};

&kscan0 {
    col-gpios
        = <&gpio0 28 GPIO_ACTIVE_HIGH>
        , <&gpio1 1  GPIO_ACTIVE_HIGH>
        , <&gpio0 29 GPIO_ACTIVE_HIGH>
        , <&gpio0 9  GPIO_ACTIVE_HIGH>
        , <&gpio0 4  GPIO_ACTIVE_HIGH>
        , <&gpio0 10 GPIO_ACTIVE_HIGH>
        ;
};

&right_encoder{
    status =  "okay";
};

/* The initial right-Central keymap includes a physical recovery action, but
 * the Studio runtime keymap may replace it like any other binding. */
&sosho_bootloader {
    compatible = "zmk,behavior-reset";
    type = <RST_UF2>;
    bootloader;
};
