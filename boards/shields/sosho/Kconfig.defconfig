## boards/shields/sosho/Kconfig.defconfig
```kconfig
if SHIELD_SOSHO_R_TRACKPAD || SHIELD_SOSHO_R_TRACKBALL || SHIELD_SOSHO_R_TRACKBALL_TOUCH || SHIELD_SOSHO_R_NONE

config ZMK_KEYBOARD_NAME
    default "sosho"

config ZMK_SPLIT
    default y

config ZMK_SPLIT_ROLE_CENTRAL
    default y

config ZMK_POINTING
    default y

config SPI
    default y

endif

if SHIELD_SOSHO_L_TRACKPAD || SHIELD_SOSHO_L_TRACKBALL || SHIELD_SOSHO_L_TRACKPAD_TOUCH || SHIELD_SOSHO_L_NONE

config ZMK_KEYBOARD_NAME
    default "sosho"

config ZMK_SPLIT
    default y

config INPUT
    default y

config ZMK_POINTING
    default y

config SPI
    default y

endif
```

## boards/shields/sosho/dts/bindings/input_processors/sosho,input-processor-axis-lock.yaml
```yaml
# SPDX-License-Identifier: MIT

description: SO-SHO dominant-axis scroll lock

compatible: "sosho,input-processor-axis-lock"

include: ip_zero_param.yaml
```

## config/west.yml
```yaml
manifest:
  defaults:
    revision: main
  remotes:
    - name: zmkfirmware
      url-base: https://github.com/zmkfirmware
    - name: caksoylar
      url-base: https://github.com/caksoylar
    - name: badjeff
      url-base: https://github.com/badjeff
    - name: elekit-official
      url-base: https://github.com/elekit-official
  projects:
    - name: zmk
      remote: zmkfirmware
      # Pin the ZMK revision used by the locally verified SO-SHO patches.
      # Studio RPC and the custom hold-tap patch must build against this API.
      revision: 4dd95d7840eb3d5a3f59bb29fbf1ab054715ef85
      import: app/west.yml
    - name: zmk-rgbled-widget
      remote: caksoylar
      revision: main
      path: modules/zmk-rgbled-widget
    - name: zmk-pmw3610-driver
      remote: badjeff
      revision: main
      path: modules/zmk-pmw3610-driver
    - name: zmk_encoder
      remote: elekit-official
      revision: 1a34a55
      path: modules/zmk_encoder
  self:
    path: config
```

## dts/bindings/behaviors/sosho,behavior-encoder-mouse-scroll.yaml
```yaml
# Copyright (c) 2026 SO-SHO Contributors
# SPDX-License-Identifier: MIT

description: SO-SHO encoder mouse scroll behavior

compatible: "sosho,behavior-encoder-mouse-scroll"

properties:
  "#sensor-binding-cells":
    type: int
    required: true
    const: 2

sensor-binding-cells:
  - param1
  - param2
```

## dts/bindings/behaviors/sosho,behavior-encoder.yaml
```yaml
# SPDX-License-Identifier: MIT

description: SO-SHO runtime-configurable rotary encoder behavior

compatible: "sosho,behavior-encoder"

include: base.yaml

properties:
  "#sensor-binding-cells":
    type: int
    required: true
    const: 2

sensor-binding-cells:
  - direction
  - sensor
```

## dts/bindings/input_processors/sosho,input-processor-axis-lock.yaml
```yaml
description: SO-SHO dominant-axis lock for relative scrolling

compatible: "sosho,input-processor-axis-lock"

include: ip_zero_param.yaml
```

## dts/bindings/input_processors/sosho,input-processor-runtime-scale.yaml
```yaml
# SPDX-License-Identifier: MIT

description: Runtime-adjustable SO-SHO relative pointing scale

compatible: "sosho,input-processor-runtime-scale"

include: ip_zero_param.yaml
```

## dts/bindings/input_processors/sosho,input-processor-trackpad-edge-scroll.yaml
```yaml
description: SO-SHO circular trackpad edge-to-wheel scroll processor

compatible: "sosho,input-processor-trackpad-edge-scroll"

include: ip_zero_param.yaml

properties:
  edge-band-percent:
    type: int
    required: false
    default: 82
    description: Percentage of the active radius that remains the normal pointer area

  scroll-divider:
    type: int
    required: false
    default: 4
    description: Divider applied to tangential edge motion before wheel events are emitted
```

## dts/bindings/input_processors/sosho,input-processor-trackpad-long-press.yaml
```yaml
description: SO-SHO trackpad tap and long-press mouse button processor

compatible: "sosho,input-processor-trackpad-long-press"

include: ip_zero_param.yaml

properties:
  long-press-ms:
    type: int
    required: false
    default: 500
    description: Contact duration in milliseconds that triggers the right button

  tap-move-threshold:
    type: int
    required: false
    default: 24
    description: Maximum accumulated relative motion after contact that still permits a tap
```
